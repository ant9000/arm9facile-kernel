## arch/arm/mach-lpc32xx/Kconfig
```kconfig
if ARCH_LPC32XX

choice
    prompt "LPC32XX SoC based board implementations"
    default MACH_PHY3250
    help
        This menu selects the LPC3250 board to support for this build

    config MACH_PHY3250
        bool "Phytec 3250 development board"
        help
            Support for the Phytec 3250 development board

    config MACH_EA3250
        bool "Embedded Artists LPC3250 Developer's Kit"
        help
            Support for the Embedded Artists LPC3250 Developer's Kit

    config MACH_FDI3250
        bool "Future Designs LPC3250 Touch screen kit"
        help
            Support for the Future Designs LPC3250 Touch screen kit

    config MACH_ARM9FACILE
        bool "Arm9Facile LPC3250 development board"
        help
            Support for the T2 Engineering Arm9Facile development board

endchoice

menu "Arm9facile Display Selection"
        depends on MACH_ARM9FACILE

config ARM9FACILE_400X272_LCD
        bool "400x272 LCD display"
	default y
        help
          Use 400x272 LCD display

config ARM9FACILE_800X480_LCD
        bool "800x480 LCD display"
        help
          Use 800x480 LCD display

config ARM9FACILE_800X600_LCD
        bool "800x600 LCD display"
        help
          Use 800x600 LCD display

endmenu



config SOM9DIMM3250_LCD_PANEL
	bool "Enables support for SOM9DIMM-LPC3250 (FDI board) LCDs"
	depends on MACH_FDI3250
	default TRUE
	help
	  Say Y here to enable QVGA/VGA panel support
	  
choice
    prompt "FDI LCD Display"
    depends on SOM9DIMM3250_LCD_PANEL
    default SOM9DIMM3250_LCD_OKAYA_VGA
    help
        Select type of LCD display to be used.

config SOM9DIMM3250_LCD_OKAYA_VGA_35
    bool "OKAYA VGA LCD on 3-5 LCD CARRIER board"
    help
      Select this option if you are using an OKAYA RV640480T on a FDI 3-5 LCD CARRIER board
      
config SOM9DIMM3250_LCD_TOSHIBA_QVGA_35
    bool "Toshiba QVGA LCD on 3-5 LCD CARRIER board"
    help
      Select this option if you are using a Toshiba LTA057A347F on a FDI 3-5 LCD CARRIER board

endchoice

menu "Standard UARTS"

config ARCH_LPC32XX_UART3_SELECT
	bool "Add support for standard UART3"
	help
	 Adds support for standard UART 3 when the 8250 serial support
	 is enabled.

config ARCH_LPC32XX_UART4_SELECT
	bool "Add support for standard UART4"
	help
	 Adds support for standard UART 4 when the 8250 serial support
	 is enabled.

config ARCH_LPC32XX_UART5_SELECT
	bool "Add support for standard UART5"
	default y
	help
	 Adds support for standard UART 5 when the 8250 serial support
	 is enabled.

config ARCH_LPC32XX_UART6_SELECT
	bool "Add support for standard UART6"
	help
	 Adds support for standard UART 6 when the 8250 serial support
	 is enabled.

endmenu

menu "High speed UARTS"

config ARCH_LPC32XX_HSUART1_SELECT
        bool "Add support for high speed UART1"
        help
                Enables high speed UART1 as a TTYSx device

config ARCH_LPC32XX_HSUART2_SELECT
        bool "Add support for high speed UART2"
        help
                Enables high speed UART2 as a TTYSx device

config ARCH_LPC32XX_HSUART7_SELECT
        bool "Add support for high speed UART7"
        help
                Enables high speed UART7 as a TTYSx device

endmenu

menu "LPC32XX chip components"

config ARCH_LPC32XX_IRAM_FOR_NET
        bool "Use IRAM for network buffers"
        help
          If the total combined required buffer sizes is larger than the
          size of IRAM, then SDRAM will be used instead.

config ARCH_LPC32XX_MII_SUPPORT
        bool "Check to enable MII support or leave disabled for RMII support"
        default FALSE
        help
          Say Y here to enable MII support, or N to RMII support. Regardless of
          which support is selected, the ethernet interface driver needs to be
          selected in the device driver networking section.

endmenu

endif
```
